## sdkconfig.defaults
```kconfig
CONFIG_COMPILER_OPTIMIZATION_SIZE=y
# CONFIG_MESH_ENABLE_PS is not set
CONFIG_ESPTOOLPY_FLASHSIZE_4MB=y
CONFIG_ESPTOOLPY_FLASHSIZE="4MB"
CONFIG_PARTITION_TABLE_CUSTOM=y
CONFIG_PARTITION_TABLE_CUSTOM_FILENAME="partitions.csv"
CONFIG_PARTITION_TABLE_FILENAME="partitions.csv"
CONFIG_BOOTLOADER_APP_ROLLBACK_ENABLE=y
CONFIG_KEEMASH_OTA_V3_ENABLE=y
CONFIG_KEEMASH_OTA_V3_TRUSTED_P256_PUBKEY_HEX="043fd1a060e612003fc6959507804a11241f70162a85c8573061ae4bdf93dbb886490c9ee94fdacea2d003674d3cf76b26875e4d0b22c24a10832de9062db4d50a"
CONFIG_KEEMASH_NODE_V2_LOG_ENABLE=y
# CONFIG_KEEMASH_V2_COMPAT_TUNNEL_ENABLE is not set
CONFIG_KEEMASH_NODE_PSRAM_EXPECTED_BYTES=0
CONFIG_FREERTOS_USE_TRACE_FACILITY=y
CONFIG_FREERTOS_GENERATE_RUN_TIME_STATS=y
CONFIG_SPIRAM=y
CONFIG_SPIRAM_TYPE_AUTO=y
CONFIG_SPIRAM_IGNORE_NOTFOUND=y
CONFIG_SPIRAM_USE_CAPS_ALLOC=y
```
